## conf/distro/pandabox.conf
```bitbake
DISTRO = "pandabox"
DISTRO_NAME = "Panda Box Multimedia Center"
DISTRO_VERSION = "v${@time.strftime('%Y.%m',time.gmtime())}"

MAINTAINER = "Mathias Fiedler"

TARGET_VENDOR = "-panda"

LOCALCONF_VERSION = "1"

PREFERRED_PROVIDER_jpeg = "libjpeg-turbo"
PREFERRED_PROVIDER_jpeg-native = "libjpeg-turbo-native"
PREFERRED_PROVIDER_virtual/egl = "pvr-omap4"
PREFERRED_PROVIDER_virtual/libgles = "pvr-omap4"
PREFERRED_PROVIDER_virtual/libgl = "pvr-omap4"
PREFERRED_PROVIDER_virtual/libgles1 = "pvr-omap4"
PREFERRED_PROVIDER_virtual/libgles2 = "pvr-omap4"
PREFERRED_PROVIDER_libgbm = "libgbm"
PREFERRED_VERSION_ti-firmware-ipu-dce = "1.6+121009+114852+git5c3f2bc"
PREFERRED_VERSION_libdce = "1.6.5"
PREFERRED_VERSION_gst-ducati = "0.10+1.6.7.2"

DISTRO_FEATURES = "alsa argp bluetooth ext2 largefile usbgadget usbhost wifi xattr nfs zeroconf x11 wayland opengles2 ${DISTRO_FEATURES_LIBC}"
```

## conf/layer.conf
```bitbake
# We have a conf and classes directory, append to BBPATH
BBPATH .= ":${LAYERDIR}"

# We have a recipes directory, add to BBFILES
BBFILES += "${LAYERDIR}/recipes*/*/*.bb ${LAYERDIR}/recipes*/*/*.bbappend"

BBFILE_COLLECTIONS += "meta-panda"
BBFILE_PATTERN_meta-panda := "^${LAYERDIR}/"
BBFILE_PRIORITY_meta-panda = "7"
```

## conf/machine/pandahard.conf
```bitbake
#@TYPE: Machine
#@NAME: Pandaboard
#@DESCRIPTION: Machine configuration for the OMAP4430 Panda

DEFAULTTUNE = "cortexa9hf-neon"

require conf/machine/pandaboard.conf
```
